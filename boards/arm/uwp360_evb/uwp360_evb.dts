/dts-v1/;

#include <unisoc/uwp360.dtsi>

/ {
	model = "UNISOC UWP360 EVB";
	compatible = "unisoc,uwp360_evb", "unisoc,uwp3", "unisoc,uwp";

	aliases {
		uart_0 = &uart0;
		uart_1 = &uart1;
	};

	chosen {
		zephyr,sram = &sram0;
		zephyr,console = &uart1;
		zephyr,flash = &flash0;
	};
};

&uart1 {
	status = "ok";
	current-speed = <115200>;
	clock-frequency = <26000000>;
};

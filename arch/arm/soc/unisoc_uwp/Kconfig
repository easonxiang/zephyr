## arch/arm/soc/unisoc_uwp/Kconfig
```kconfig
# Kconfig - UNISOC UWP360 soc
#

config SOC_FAMILY_UWP
	bool
	# omit prompt to signify a "hidden" option
	default n

if SOC_FAMILY_UWP
config SOC_FAMILY
	string
	default unisoc_uwp
endif

source "arch/arm/soc/unisoc_uwp/uwp3/Kconfig.soc"
```

## arch/arm/soc/unisoc_uwp/Kconfig.soc
```kconfig
# Kconfig - UNISOC UWP Soc
#

source "arch/arm/soc/unisoc_uwp/uwp3/Kconfig.series"
```

## arch/arm/soc/unisoc_uwp/uwp3/Kconfig.defconfig.series
```kconfig
# Kconfig.defconfig.series - UNISOC UWP Family
#

if SOC_SERIES_UWP3

source "arch/arm/soc/unisoc_uwp/uwp3/Kconfig.defconfig.uwp360"

config SOC_SERIES
	default uwp3

endif # SOC_SERIES_UWP3
```

## arch/arm/soc/unisoc_uwp/uwp3/Kconfig.defconfig.uwp360
```kconfig
# Kconfig.defconfig.uwp360 - UNISOC UWP360
#

if SOC_UWP360

config SOC
	string
	default uwp360

config NUM_IRQS
	int
	# must be >= the highest interrupt number used
	default 179

config SYS_CLOCK_HW_CYCLES_PER_SEC
	int
	default 416000000

config TEXT_SECTION_OFFSET
	int
	default 0x0 if !BOOTLOADER_MCUBOOT
	default 0x200 if BOOTLOADER_MCUBOOT

endif # SOC_UWP360
```

## arch/arm/soc/unisoc_uwp/uwp3/Kconfig.series
```kconfig
# Kconfig.series - UNISOC UWP3
#

config  SOC_SERIES_UWP3
	bool "Unisoc UWP3"
	select CPU_CORTEX_M4
	select SOC_FAMILY_UWP
	select CPU_HAS_SYSTICK
	help
	  Enable support for Unisoc UWP3
```

## arch/arm/soc/unisoc_uwp/uwp3/Kconfig.soc
```kconfig
# Kconfig.soc - UNISOC UWP360
#

choice
prompt "Unisoc UWP360 MCU Selection"
depends on SOC_SERIES_UWP3

config SOC_UWP360
	bool "uwp360"
endchoice

if SOC_UWP360

config UWP360_DEBUG
	bool "Prepend debug header, disabling flash verification"
	default y
#	depends on XIP
#	default y if XIP
#	default n if !XIP

endif # SOC_UWP360
```

## boards/arm/uwp360_evb/Kconfig.board
```kconfig
# Kconfig - UNISOC UWP360 EVB Board
#

config  BOARD_UWP360_EVB
	bool "UNISOC uwp360 evb"
	depends on SOC_UWP360
```

## boards/arm/uwp360_evb/Kconfig.defconfig
```kconfig
# Kconfig - UNISOC UWP360 EVB board configuration
#

if BOARD_UWP360_EVB

config BOARD
	default uwp360_evb

endif # BOARD_UWP360_EVB
```

## boards/arm/uwp360_evb/uwp360_evb_defconfig
```kconfig
CONFIG_ARM=y
CONFIG_SOC_FAMILY_UWP=y
CONFIG_SOC_SERIES_UWP3=y
CONFIG_SOC_UWP360=y
CONFIG_BOARD_UWP360_EVB=y
CONFIG_CORTEX_M_SYSTICK=y
CONFIG_FLASH=n
CONFIG_XIP=n
CONFIG_HAS_UWP360=y
CONFIG_USE_UWP360_HAL_UART=y

CONFIG_PRINTK=y

#enable GPIO driver
CONFIG_GPIO=y
CONFIG_GPIO_UWP360=y
CONFIG_GPIO_UWP360_P0=y

# enable uart driver
CONFIG_SERIAL=y
CONFIG_SERIAL_HAS_DRIVER=y
CONFIG_UART_UWP360=y
CONFIG_UART_INTERRUPT_DRIVEN=y

# enable console
CONFIG_CONSOLE=y
CONFIG_UART_CONSOLE=y

CONFIG_WATCHDOG=y
CONFIG_WDT_UWP360=y
CONFIG_FLASH=y
CONFIG_SOC_FLASH_UWP360=y
CONFIG_USE_UWP360_HAL_SFC=y

CONFIG_INTC_UWP360=y
CONFIG_EIC_UWP360=y
CONFIG_AON_INTC_UWP360=y
CONFIG_AON_EIC_UWP360=y
```

## drivers/gpio/Kconfig.uwp360
```kconfig
# Kconfig.cc32xx- CC32XX GPIO configuration options
#

menuconfig GPIO_UWP360
	bool "Unisoc UWP360 GPIO driver"
	depends on GPIO && SOC_FAMILY_UWP
	default n
	help
	  Enable the GPIO driver on TI SimpleLink CC32xx boards

if GPIO_UWP360

config GPIO_UWP360_P0
	bool "GPIO block A0"
	depends on GPIO_UWP360
	default n
	help
	  Include support for the GPIO port A0.

config GPIO_UWP360_P0_NAME
	string "Driver name"
	depends on GPIO_UWP360_P0
	default "GPIO_P0"

endif # GPIO_UWP360
```

## drivers/interrupt_controller/Kconfig.uwp360
```kconfig
#
# Copyright (c) 2018, UNISOC Incorporated
#
# SPDX-License-Identifier: Apache-2.0
#

menuconfig INTC_UWP360
	bool "UNISOC UWP360 Interrupt Controller Driver"
	depends on SOC_FAMILY_UWP
	default y
	help
	  Enable INTC driver for UNISOC UWP360 MCU.

config INTC_UWP360_DEVICE_NAME
	string "Device name for Interrupt Controller"
	depends on INTC_UWP360
	default "UWP360_INTC"
	help
	  Set the name used by INTC device during registration.

menuconfig AON_INTC_UWP360
	bool "UNISOC UWP360 AON Interrupt Controller Driver"
	depends on SOC_FAMILY_UWP
	default y
	help
	  Enable AON INTC driver for UNISOC UWP360 MCU.

config AON_INTC_UWP360_DEVICE_NAME
	string "Device name for AON Interrupt Controller"
	depends on INTC_UWP360
	default "UWP360_AON_INTC"
	help
	  Set the name used by AON INTC device during registration.
	  
menuconfig EIC_UWP360
	bool "UNISOC UWP360 Interrupt Controller Driver"
	depends on SOC_FAMILY_UWP
	default y
	help
	  Enable EIC driver for UNISOC UWP360 MCU.

config EIC_UWP360_DEVICE_NAME
	string "Device name for Interrupt Controller"
	depends on EIC_UWP360
	default "UWP360_EIC"
	help
	  Set the name used by EIC device during registration.

menuconfig IPI_UWP360
	bool "UNISOC UWP360 IPI Interrupt Controller Driver"
	depends on SOC_FAMILY_UWP
	default y
	help
	  Enable IPI driver for UNISOC UWP360 MCU.

config IPI_UWP360_DEVICE_NAME
	string "Device name for IPI Interrupt Controller"
	depends on IPI_UWP360
	default "UWP360_IPI"
	help
	  Set the name used by IPI device during registration.
```

## drivers/serial/Kconfig.uwp360
```kconfig
menuconfig UART_UWP360
	depends on SOC_SERIES_UWP3
	bool "UWP360 UART driver"
	default n
	select SERIAL_HAS_DRIVER
	select SERIAL_SUPPORT_INTERRUPT
	depends on SOC_FAMILY_UWP
	help
	  This option enables the UWP360 UART driver, for UART_0.

menuconfig UART_AON_UWP360
	depends on SOC_SERIES_UWP3
	bool "UWP360 AON UART driver"
	default n
	select SERIAL_HAS_DRIVER
	select SERIAL_SUPPORT_INTERRUPT
	depends on SOC_FAMILY_UWP
	help
	  This option enables the UWP360 AON UART driver.
```

## drivers/watchdog/Kconfig.uwp360
```kconfig
#
# Copyright (c) 2018, UNISOC Incorporated
#
# SPDX-License-Identifier: Apache-2.0
#

menuconfig WDT_UWP360
	bool "UNISOC UWP360 Watchdog Driver"
	depends on SOC_FAMILY_UWP
	default y
	help
	  Enable WDT driver for UNISOC UWP360 MCU.

config WDT_UWP360_DEVICE_NAME
	string "Device name for Watchdog"
	depends on WDT_UWP360
	default "UWP360_WDT"
	help
	  Set the name used by WDT device during registration.
```

## drivers/wifi/uwp360/Kconfig
```kconfig
menuconfig WIFI_UWP360
	bool "Unisoc uwp360 wifi driver support"
	default y
	select WIFI_OFFLOAD
	select NET_L2_WIFI_MGMT

if WIFI_UWP360
config WIFI_UWP360_NAME
	string "Driver name"
	default "UWP360_WIFI"
endif
```

## ext/hal/unisoc/Kconfig
```kconfig
config HAS_UWP360
	bool
	depends on SOC_FAMILY_UWP
	default y

if HAS_UWP360

config USE_UWP360_HAL_UART
	bool
	default y


endif
```

## ext/hal/unisoc/uwp360/Kconfig
```kconfig
config HAS_UWP360
	bool
	depends on SOC_FAMILY_UWP
	default y

if HAS_UWP360

config USE_UWP360_HAL_UART
	bool
	default y

config USE_UWP360_HAL_SFC
   bool
   default y

endif
```

## ext/lib/ipc/Kconfig
```kconfig
menuconfig SIPC
	bool "Unisoc UWP360 SIPC"
	default n
	help
	  This option enables the UWP360 SIPC feature.
```

## ext/lib/ipc/sipc/Kconfig
```kconfig
config SIPC 
        bool "sipc lib"
        default n
        help
		  enbale sipc feature
```

## ext/lib/iwnpi/Kconfig
```kconfig
config SYSTEM_IWNPI
        bool "iwnpi tool for wifi npi test"
        default n
        ---help---
                Enable the iwnpi tool for wifi npi test
if SYSTEM_IWNPI

config SYSTEM_IWNPI_PROGNAME
    string "Proram name"
    default "iwnpi"
    depends on BUILD_KERNEL
    ---help---
        This is the name of the program that will be use when the NSH ELF
        program is installed.
endif
```

## subsys/net/l2/wifi/Kconfig
```kconfig
#
# Copyright (c) 2016 Intel Corporation.
#
# SPDX-License-Identifier: Apache-2.0
#

menuconfig NET_L2_WIFI
	bool "Enable WIFI link layer"
	help
	  Add support for WIFI link layer.

if NET_L2_WIFI
module = NET_L2_WIFI
module-dep = NET_LOG
module-str = Log level for IEEE 802.15.4
module-help = Enables IEEE 802.15.4 code to output debug messages.
endif
```
